## package/c3270/Config.in
```kconfig
config BR2_PACKAGE_C3270
	bool "c3270"
	select BR2_USE_WCHAR
	select BR2_PACKAGE_LIBOPENSSL
	select BR2_PACKAGE_NCURSES
	select BR2_PACKAGE_NCURSES_WCHAR
	select BR2_PACKAGE_READLINE
	help
	  Interactive 3270 emulator that runs on a character-mode terminal on a POSIX system
```
